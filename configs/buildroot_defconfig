## configs/buildroot_defconfig
```kconfig
BR2_arm=y
BR2_cortex_a7=y
BR2_ARM_FPU_VFPV4=y
BR2_SVN="svn"
BR2_CCACHE=y
BR2_GLOBAL_PATCH_DIR="$(TOPDIR)/../patches/buildroot"
BR2_TOOLCHAIN_BUILDROOT_GLIBC=y
BR2_PACKAGE_HOST_LINUX_HEADERS_CUSTOM_5_2=y
BR2_BINUTILS_VERSION_2_31_X=y
BR2_GCC_VERSION_7_X=y
BR2_TOOLCHAIN_BUILDROOT_CXX=y
BR2_TOOLCHAIN_BUILDROOT_FORTRAN=y
BR2_GCC_ENABLE_LTO=y
BR2_GCC_ENABLE_OPENMP=y
BR2_GCC_ENABLE_GRAPHITE=y
BR2_TARGET_GENERIC_HOSTNAME="nanopi-neo"
BR2_TARGET_GENERIC_ISSUE="Welcome to Buildroot for the NanoPi NEO"
BR2_ROOTFS_DEVICE_CREATION_DYNAMIC_EUDEV=y
BR2_TARGET_GENERIC_ROOT_PASSWD="root"
BR2_ROOTFS_OVERLAY="$(TOPDIR)/../configs/overlay/"
BR2_ROOTFS_POST_BUILD_SCRIPT="$(TOPDIR)/../configs/post-build.sh"
BR2_ROOTFS_POST_IMAGE_SCRIPT="$(TOPDIR)/../configs/post-image.sh"
BR2_LINUX_KERNEL=y
BR2_LINUX_KERNEL_CUSTOM_VERSION=y
BR2_LINUX_KERNEL_CUSTOM_VERSION_VALUE="5.2.21"
BR2_LINUX_KERNEL_PATCH="$(TOPDIR)/../patches/kernel"
BR2_LINUX_KERNEL_USE_CUSTOM_CONFIG=y
BR2_LINUX_KERNEL_CUSTOM_CONFIG_FILE="$(TOPDIR)/../configs/linux_defconfig"
BR2_LINUX_KERNEL_DTS_SUPPORT=y
BR2_LINUX_KERNEL_INTREE_DTS_NAME="sun8i-h3-nanopi-neo"
BR2_PACKAGE_BUSYBOX_CONFIG="$(TOPDIR)/../configs/busybox.config"
BR2_PACKAGE_BUSYBOX_SHOW_OTHERS=y
BR2_PACKAGE_BUSYBOX_INDIVIDUAL_BINARIES=y
BR2_PACKAGE_ALSA_UTILS_ALSACONF=y
BR2_PACKAGE_ALSA_UTILS_ACONNECT=y
BR2_PACKAGE_ALSA_UTILS_ALSALOOP=y
BR2_PACKAGE_ALSA_UTILS_ALSAUCM=y
BR2_PACKAGE_ALSA_UTILS_ALSATPLG=y
BR2_PACKAGE_ALSA_UTILS_AMIDI=y
BR2_PACKAGE_ALSA_UTILS_AMIXER=y
BR2_PACKAGE_ALSA_UTILS_APLAY=y
BR2_PACKAGE_ALSA_UTILS_APLAYMIDI=y
BR2_PACKAGE_ALSA_UTILS_ARECORDMIDI=y
BR2_PACKAGE_ALSA_UTILS_ASEQDUMP=y
BR2_PACKAGE_ALSA_UTILS_ASEQNET=y
BR2_PACKAGE_ALSA_UTILS_BAT=y
BR2_PACKAGE_ALSA_UTILS_IECSET=y
BR2_PACKAGE_ALSA_UTILS_SPEAKER_TEST=y
BR2_PACKAGE_ATEST=y
BR2_PACKAGE_AUMIX=y
BR2_PACKAGE_ESPEAK=y
BR2_PACKAGE_ESPEAK_AUDIO_BACKEND_ALSA=y
BR2_PACKAGE_FLITE=y
BR2_PACKAGE_LAME=y
BR2_PACKAGE_ORCA=y
BR2_PACKAGE_PUREDATA=y
BR2_PACKAGE_TRX=y
BR2_PACKAGE_UNZIP=y
BR2_PACKAGE_ZIP=y
BR2_PACKAGE_RT_TESTS=y
BR2_PACKAGE_STRACE=y
BR2_PACKAGE_STRESS=y
BR2_PACKAGE_BINUTILS=y
BR2_PACKAGE_BINUTILS_TARGET=y
BR2_PACKAGE_FINDUTILS=y
BR2_PACKAGE_GETTEXT=y
BR2_PACKAGE_GREP=y
BR2_PACKAGE_PATCH=y
BR2_PACKAGE_SED=y
BR2_PACKAGE_TREE=y
BR2_PACKAGE_DOSFSTOOLS=y
BR2_PACKAGE_DOSFSTOOLS_FATLABEL=y
BR2_PACKAGE_DOSFSTOOLS_FSCK_FAT=y
BR2_PACKAGE_DOSFSTOOLS_MKFS_FAT=y
BR2_PACKAGE_E2FSPROGS_E4DEFRAG=y
BR2_PACKAGE_E2TOOLS=y
BR2_PACKAGE_EXFAT=y
BR2_PACKAGE_EXFAT_UTILS=y
BR2_PACKAGE_NTFS_3G=y
BR2_PACKAGE_SSHFS=y
BR2_PACKAGE_LIBERATION=y
# BR2_PACKAGE_LIBERATION_MONO is not set
# BR2_PACKAGE_LIBERATION_SANS is not set
# BR2_PACKAGE_LIBERATION_SERIF is not set
BR2_PACKAGE_XLIB_LIBXTST=y
BR2_PACKAGE_XAPP_XAUTH=y
BR2_PACKAGE_XAPP_XKBCOMP=y
BR2_PACKAGE_XFONT_FONT_UTIL=y
BR2_PACKAGE_XFONT_ENCODINGS=y
BR2_PACKAGE_MCOOKIE=y
BR2_PACKAGE_XDATA_XBITMAPS=y
BR2_PACKAGE_LINUX_FIRMWARE=y
BR2_PACKAGE_LINUX_FIRMWARE_MEDIATEK_MT7601U=y
BR2_PACKAGE_LINUX_FIRMWARE_RTL_81XX=y
BR2_PACKAGE_DBUS_GLIB=y
BR2_PACKAGE_EUDEV_RULES_GEN=y
BR2_PACKAGE_I2C_TOOLS=y
BR2_PACKAGE_PARTED=y
BR2_PACKAGE_STM32FLASH=y
BR2_PACKAGE_USBMOUNT=y
BR2_PACKAGE_PYTHON=y
BR2_PACKAGE_PYTHON_PY_PYC=y
BR2_PACKAGE_PYTHON_CURSES=y
BR2_PACKAGE_PYTHON_READLINE=y
BR2_PACKAGE_PYTHON_LXML=y
BR2_PACKAGE_PYTHON_PYTZ=y
BR2_PACKAGE_PYTHON_SERIAL=y
BR2_PACKAGE_PYTHON_SETUPTOOLS=y
BR2_PACKAGE_PYTHON_SIX=y
# BR2_PACKAGE_TCL_SHLIB_ONLY is not set
BR2_PACKAGE_EXPECT=y
BR2_PACKAGE_TCLLIB=y
BR2_PACKAGE_ALSA_LIB_PYTHON=y
BR2_PACKAGE_AUDIOFILE=y
BR2_PACKAGE_LIBG7221=y
BR2_PACKAGE_LIBILBC=y
BR2_PACKAGE_LIBLO=y
BR2_PACKAGE_LIBMAD=y
BR2_PACKAGE_LIBSNDFILE=y
BR2_PACKAGE_LIBSOUNDTOUCH=y
BR2_PACKAGE_LIBSOXR=y
BR2_PACKAGE_LIBVORBIS=y
BR2_PACKAGE_OPENAL=y
BR2_PACKAGE_PORTAUDIO_OSS=y
BR2_PACKAGE_SPEEX=y
BR2_PACKAGE_DTC=y
BR2_PACKAGE_DTC_PROGRAMS=y
BR2_PACKAGE_LIBGPIOD=y
BR2_PACKAGE_LIBGPIOD_TOOLS=y
BR2_PACKAGE_LIBGUDEV=y
BR2_PACKAGE_LIBPCIACCESS=y
BR2_PACKAGE_TSLIB=y
BR2_PACKAGE_JANSSON=y
BR2_PACKAGE_LIBAACS=y
BR2_PACKAGE_LIBMNL=y
BR2_PACKAGE_LIBTIRPC=y
BR2_PACKAGE_FFTW=y
BR2_PACKAGE_FFTW_FAST=y
BR2_PACKAGE_SPHINXBASE=y
BR2_PACKAGE_LIBFRIBIDI=y
BR2_PACKAGE_LIBUNISTRING=y
BR2_PACKAGE_NCURSES_WCHAR=y
BR2_PACKAGE_NCURSES_TARGET_PROGS=y
BR2_PACKAGE_BC=y
BR2_PACKAGE_AVAHI=y
BR2_PACKAGE_AVAHI_DAEMON=y
BR2_PACKAGE_AVAHI_LIBDNSSD_COMPATIBILITY=y
BR2_PACKAGE_BRIDGE_UTILS=y
BR2_PACKAGE_DHCPCD=y
BR2_PACKAGE_DNSMASQ=y
# BR2_PACKAGE_DNSMASQ_TFTP is not set
BR2_PACKAGE_HOSTAPD=y
BR2_PACKAGE_HOSTAPD_EAP=y
BR2_PACKAGE_HOSTAPD_WPS=y
BR2_PACKAGE_IFUPDOWN=y
BR2_PACKAGE_IW=y
BR2_PACKAGE_NET_TOOLS=y
BR2_PACKAGE_NETWORK_MANAGER=y
BR2_PACKAGE_NETWORK_MANAGER_TUI=y
BR2_PACKAGE_NTP=y
BR2_PACKAGE_NTP_NTPDATE=y
BR2_PACKAGE_RSYNC=y
BR2_PACKAGE_SAMBA4=y
BR2_PACKAGE_SAMBA4_ADS=y
BR2_PACKAGE_SHELLINABOX=y
BR2_PACKAGE_SSHPASS=y
BR2_PACKAGE_WAVEMON=y
BR2_PACKAGE_WGET=y
BR2_PACKAGE_WIREGUARD_LINUX_COMPAT=y
BR2_PACKAGE_WIREGUARD_TOOLS=y
BR2_PACKAGE_WPA_SUPPLICANT=y
BR2_PACKAGE_WPA_SUPPLICANT_AP_SUPPORT=y
BR2_PACKAGE_WPA_SUPPLICANT_WIFI_DISPLAY=y
BR2_PACKAGE_WPA_SUPPLICANT_MESH_NETWORKING=y
BR2_PACKAGE_WPA_SUPPLICANT_AUTOSCAN=y
BR2_PACKAGE_WPA_SUPPLICANT_EAP=y
BR2_PACKAGE_WPA_SUPPLICANT_HOTSPOT=y
BR2_PACKAGE_WPA_SUPPLICANT_DEBUG_SYSLOG=y
BR2_PACKAGE_WPA_SUPPLICANT_WPS=y
BR2_PACKAGE_WPA_SUPPLICANT_CLI=y
BR2_PACKAGE_WPA_SUPPLICANT_WPA_CLIENT_SO=y
BR2_PACKAGE_WPA_SUPPLICANT_PASSPHRASE=y
BR2_PACKAGE_WPA_SUPPLICANT_DBUS=y
BR2_PACKAGE_BASH=y
BR2_PACKAGE_FILE=y
BR2_PACKAGE_INOTIFY_TOOLS=y
BR2_PACKAGE_SCREEN=y
BR2_PACKAGE_TMUX=y
BR2_PACKAGE_WHICH=y
BR2_PACKAGE_HTOP=y
BR2_PACKAGE_UTIL_LINUX_LOSETUP=y
BR2_PACKAGE_UTIL_LINUX_MOUNT=y
BR2_PACKAGE_UTIL_LINUX_PARTX=y
BR2_PACKAGE_UTIL_LINUX_PIVOT_ROOT=y
BR2_PACKAGE_UTIL_LINUX_RFKILL=y
BR2_PACKAGE_UTIL_LINUX_SCHEDUTILS=y
BR2_PACKAGE_UTIL_LINUX_SWITCH_ROOT=y
BR2_PACKAGE_NANO=y
BR2_PACKAGE_VIM=y
BR2_TARGET_ROOTFS_EXT2=y
BR2_TARGET_ROOTFS_EXT2_4=y
BR2_TARGET_ROOTFS_EXT2_SIZE="700m"
BR2_TARGET_ROOTFS_EXT2_RESBLKS=0
BR2_TARGET_ROOTFS_EXT2_MKFS_OPTIONS=""
# BR2_TARGET_ROOTFS_TAR is not set
BR2_TARGET_UBOOT=y
BR2_TARGET_UBOOT_PATCH="$(TOPDIR)/../patches/u-boot"
BR2_TARGET_UBOOT_BOARD_DEFCONFIG="nanopi_neo"
BR2_TARGET_UBOOT_NEEDS_DTC=y
BR2_TARGET_UBOOT_FORMAT_CUSTOM=y
BR2_TARGET_UBOOT_FORMAT_CUSTOM_NAME="u-boot-sunxi-with-spl.bin"
BR2_PACKAGE_HOST_DOSFSTOOLS=y
BR2_PACKAGE_HOST_GENEXT2FS=y
BR2_PACKAGE_HOST_GENIMAGE=y
BR2_PACKAGE_HOST_MTOOLS=y
BR2_PACKAGE_HOST_UBOOT_TOOLS=y
```

## synth/Config.in
```kconfig
source "$BR2_EXTERNAL_SYNTH_PATH/package/puredata/Config.in"
source "$BR2_EXTERNAL_SYNTH_PATH/package/orca/Config.in"
source "$BR2_EXTERNAL_SYNTH_PATH/package/trx/Config.in"
```

## synth/package/orca/Config.in
```kconfig
config BR2_PACKAGE_ORCA
	bool "orca"
	select BR2_PACKAGE_NCURSES
	
	help
		ncurses atypical sequencer
```

## synth/package/puredata/Config.in
```kconfig
config BR2_PACKAGE_PUREDATA
	bool "puredata"
	select BR2_PACKAGE_GETTEXT
	select BR2_PACKAGE_TK
	select BR2_PACKAGE_TCL
	
	help
		graphic realtime audio programming language
```

## synth/package/trx/Config.in
```kconfig
config BR2_PACKAGE_TRX
	bool "trx"
	select BR2_PACKAGE_OPUS
	select BR2_PACKAGE_OPUSFILE
    select BR2_PACKAGE_ORTP
	
	help
		realtime audio stream lib
```
